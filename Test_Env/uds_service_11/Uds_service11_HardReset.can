/*@!Encoding:1252*/
includes
{
  
  #include "..\Include\Diag_security_access.cin"
}

variables
{

}

void Service_request_11_data(byte sub)
{
 Diag_req.byte(0)= 0x02;
 Diag_req.byte(1)= 0x11;
 Diag_req.byte(2)= sub;
 output(Diag_req);
}
testcase Uds_service11_hardreset()
{
  Service_request_11_data(0x01);
  test_flag=1;
  testWaitForTimeout(100);
  
  if((Response[0]==0x03)&& (Response[1]==0x51)&&(Response[2]==0x01))
  {
    testStepPass("","Hard Reset pass %x %x %x %x %x %x %x",Response[0],Response[1],Response[2]);
  }
  else
  {
    testStepFail("","Hard Reset fail %x %x %x %x %x %x %x",Response[0],Response[1],Response[2]);
  }
  
}


MainTest()
{
  security_unlock();
  Uds_service11_hardreset();
}