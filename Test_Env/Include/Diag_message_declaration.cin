/*@!Encoding:1252*/
includes
{
  
}

variables
{
  message  0x200  Diag_req;
  message  0x201  Diag_resp;
  byte Response[8];
  byte i,test_flag;
}

on message 0x201
{
  if(test_flag==1)
  {
  for (i=0;i<8;i++)
  {
  Response[i]= this.byte(i);
  }
  test_flag=0;
  }
}