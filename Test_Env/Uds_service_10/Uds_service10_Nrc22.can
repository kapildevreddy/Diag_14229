/*@!Encoding:1252*/
includes
{
  
  #include "..\Include\Diag_message_declaration.cin"
}

variables
{

}
void Service_request_10_data(byte sub)
{
 Diag_req.byte(0)= 0x02;
 Diag_req.byte(1)= 0x10;
 Diag_req.byte(2)= sub;
 output(Diag_req);
}



testcase Uds_service_nrc22()
{

  //$Speed =10;
  setSignal(ENGmsg::Speed,10);  // Speed more than 5kmph
  testWaitForTimeout(3000);
  Service_request_10_data(0x01);
  test_flag=1;
  testWaitForTimeout(100);
  
  if((Response[0]==0x03)&& (Response[1]==0x7F)&&(Response[2]==0x10)&&(Response[3]==0x22))
  {
    testStepPass("","conditionsNotCorrect test pass %x %x %x %x %x %x %x",Response[0],Response[1],Response[2],Response[3]);
  }
  else
  {
    testStepFail("","conditionsNotCorrect  test fail %x %x %x %x %x %x %x , Speed %d",Response[0],Response[1],Response[2],Response[3],Response[4],Response[5],Response[6],getSignal(Speed));
  
  }
   
   setSignal(ENGmsg::Speed,0);  // reset speed
}



MainTest()
{
  Uds_service_nrc22();
}