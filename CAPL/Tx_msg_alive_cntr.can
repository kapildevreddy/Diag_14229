/*@!Encoding:1252*/
includes
{
  
}

variables
{
 message 0x200 BRK_msg; //message declaration
 msTimer tmr_BRK_msg; // timer for BRK
 byte cnt =0;
}

on timer tmr_BRK_msg
{
  BRK_MSG_def();
  setTimer(tmr_BRK_msg,1000);
}

void BRK_MSG_def()
{
  BRK_msg.dlc = 8; //lenth
  if(cnt<8)
  {
 BRK_msg.byte(0)=cnt;
  }
  else
  {
    cnt =0;
  BRK_msg.byte(0)=cnt;
  }
  BRK_msg.byte(1)=0x02;
  BRK_msg.byte(2)=0x03;
  BRK_msg.byte(3)=0x04;
  BRK_msg.byte(4)=0x05;
  BRK_msg.byte(5)=0x06;
  BRK_msg.byte(6)=0x07;
  BRK_msg.byte(7)=0x08;
  cnt++;
  output(BRK_msg);
  
}


 
on start
{
  setTimer(tmr_BRK_msg,500);
}