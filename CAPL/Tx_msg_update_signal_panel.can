/*@!Encoding:1252*/
includes
{
  
}

variables
{
 message 0x57E BRK_msg; //message declaration 
 msTimer tmr_BRK_msg; // timer for BRK
 byte msg_cntr=1;
}

on timer tmr_BRK_msg
{
  BRK_MSG_def();
  setTimer(tmr_BRK_msg,200);
  }
//on sysvar_update power::on
//{
// msg_cntr= @power::on;
////  if(msg_cntr==1)
////  {
////    setTimer(tmr_BRK_msg,200);
////  }
////  else
////  {
////    cancelTimer(tmr_BRK_msg);
////  }
//}
on envVar Power_on
{
 msg_cntr= @Power_on; 
//  if(msg_cntr==1)
//  {
//    setTimer(tmr_BRK_msg,200);
//  }
//  else
//  {
//    cancelTimer(tmr_BRK_msg);
//  }
}
void BRK_MSG_def()
{
  BRK_msg.dlc = 8; //lenth
  BRK_msg.byte(0)=0x01; //data
  BRK_msg.byte(1)=0x02;
  BRK_msg.byte(2)=0x03;
  BRK_msg.byte(3)=0x04;
  BRK_msg.byte(4)=0x05;
  BRK_msg.byte(5)=0x06;
  BRK_msg.byte(6)=0x07;
  BRK_msg.byte(7)=msg_cntr;
  output(BRK_msg);
}


 
on start
{
  setTimer(tmr_BRK_msg,200);
}